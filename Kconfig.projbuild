## Kconfig.projbuild
```kconfig
menu "Falcon camera emulator"

choice FALCON_USB_ID
    prompt "Emulated USB identity"
    default FALCON_USB_ID_XBOX
    help
        Which device the ESP32 presents to the host. The Xbox identity is what the
        original Xbox Video Chat app expects; the EyeToy identity is matched by the
        Linux gspca_ov519 driver, so use it to preview the checkerboard on a PC.

    config FALCON_USB_ID_XBOX
        bool "Xbox Video Camera (045E:028C)"

    config FALCON_USB_ID_EYETOY
        bool "Sony EyeToy (054C:0155) - Linux gspca_ov519 testable"
endchoice

endmenu
```

## main/Kconfig.projbuild
```kconfig
menu "Falcon camera emulator"

choice FALCON_MODE
    prompt "Camera mode"
    default FALCON_MODE_OV519
    help
        OV519 = faithful Xbox Video Camera (vendor OV519/OV530, MJPEG over iso) —
        what the real Xbox Video Chat app expects, and Linux gspca_ov519.
        UVC dev = a standard UVC MJPEG camera so a PC (Windows Camera app, OBS,
        ffplay) previews the stream with no driver. Use it to bring up + verify the
        ESP32 streaming pipeline on a PC before involving the Xbox.

    config FALCON_MODE_OV519
        bool "Faithful Xbox Video Camera (OV519/OV530)"

    config FALCON_MODE_UVC
        bool "UVC dev camera (PC preview, plug-and-play)"
endchoice

choice FALCON_USB_ID
    prompt "OV519 USB identity"
    depends on FALCON_MODE_OV519
    default FALCON_USB_ID_XBOX
    help
        Which device the OV519 mode presents. Xbox = what the Video Chat app
        expects; EyeToy = matched by Linux gspca_ov519 (use it to preview the
        faithful build on a Linux PC).

    config FALCON_USB_ID_XBOX
        bool "Xbox Video Camera (045E:028C)"

    config FALCON_USB_ID_EYETOY
        bool "Sony EyeToy (054C:0155) - Linux gspca_ov519 testable"
endchoice

config FALCON_WIFI_LOG
    bool "WiFi UDP live-log broadcast (debug only; needs main/wifi_creds.h)"
    depends on FALCON_MODE_OV519
    default n
    help
        Mirror every ESP_LOG line as a UDP broadcast on port 5555 so a PC on the
        LAN can watch the camera while it is plugged into a distant Xbox. When
        enabled, main/wifi_log.c is compiled and requires a local, gitignored
        main/wifi_creds.h with your SSID/password (copy main/wifi_creds.h.example).

        Keep this OFF for real Xbox tests: joining WiFi loads the CPU/radio enough
        to break the Xbox's timing-strict USB enumeration. It is off by default so
        the project builds with no secrets present.

endmenu
```
